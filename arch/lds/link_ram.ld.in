/*
 * Copyright (C) 2026 Hustler Lo.
 *
 * SPDX-License-Identifier: BSD-3-Clause
 */

OUTPUT_ARCH(aarch64)
ENTRY(_start)
EXTERN(_start)

/*
 * 2026-06-30, ARM64 RAM-link principle:
 *
 * This script describes the virtual/physical RAM image expected by the early
 * EL2 boot path. CONFIG_HV_RAM_START is the address where firmware/QEMU places
 * the BEAU image, and the startup code uses the linker symbols below before C
 * runtime services exist.
 *
 *   CONFIG_HV_RAM_START
 *        |
 *        v
 *   optional image header -> .text.entry -> .text -> .rodata -> .rela
 *                         -> .data -> .boot_stack -> .bss
 *
 * Keep the section order and exported symbols synchronized with
 * arch/arm64/boot/entry.S, arch/arm64/boot/reloc.c, and ld_sym.h.
 */
SECTIONS
{
	/*
	 * The location counter is the link-time address of the first byte in
	 * the image. ARM64 reloc.c measures any actual load delta by comparing
	 * the runtime address of _start against this configured base.
	 */
	. = CONFIG_HV_RAM_START;

	/*
	 * ld_ram_start/ld_ram_end bracket the full load image. Common boot code
	 * uses this pair to describe image size without knowing each section.
	 */
	ld_ram_start = .;

	/*
	 * Keep the optional U-Boot Image header before the raw reset entry. When
	 * disabled the input section is absent and .text.entry remains at offset 0.
	 */
	.text : {
		_text_start = .;
		ld_image_header_start = .;
		KEEP(*(.image_header))
		ld_image_header_end = .;
		KEEP(*(.text.entry))
		*(.text)
		*(.text.*)
		*(.note.gnu.build-id)
		. = ALIGN(8);
		_text_end = .;
	}

	. = ALIGN(0x1000);

	/*
	 * Read-only data sits on its own page boundary so later EL2 stage-1
	 * mappings can assign text/data permissions at page granularity.
	 */
	.rodata : {
		_rodata_start = .;
		*(.rodata)
		*(.rodata.*)
		. = ALIGN(8);
		_rodata_end = .;
	}

	. = ALIGN(0x1000);

	/*
	 * Relocation and dynamic records are grouped even though the first-stage
	 * ARM64 port does not apply dynamic relocations yet. Keeping the records
	 * in a known range avoids mixing metadata into writable runtime data.
	 */
	.rela : {
		*(.rela)
		*(.rela.*)
		*(.dyn*)
	}

	. = ALIGN(0x1000);

	/*
	 * Writable initialized data follows another page boundary. Objects that
	 * request .data.page_aligned are placed first so page-table-like data can
	 * keep its alignment contract after linking.
	 */
	.data : {
		_data_start = .;
		*(.data.page_aligned)
		*(.data)
		*(.data.*)
		. = ALIGN(8);
		_data_end = .;
	}

	/* objcopy ends the raw binary here; later sections are zero-filled RAM. */
	ld_image_end = .;
	ld_image_size = ld_image_end - ld_ram_start;

	. = ALIGN(0x1000);

	/*
	 * The BSP uses this temporary full-descending stack only long enough to
	 * enter C and build the per-pCPU stack model. _boot_stack_end is the
	 * initial SP_EL2 value written by entry.S.
	 */
	.boot_stack : {
		_boot_stack_start = .;
		. += 0x1000;
		. = ALIGN(16);
		_boot_stack_end = .;
	}

	. = ALIGN(0x1000);

	/*
	 * NOLOAD keeps zero-initialized storage out of the file image. The entry
	 * code clears [_bss_start, _bss_end) explicitly before C code observes
	 * globals, so the binary stays small while runtime state is still clean.
	 */
	.bss (NOLOAD) : {
		_bss_start = .;
		*(.bss)
		*(.bss.*)
		*(COMMON)
		. = ALIGN(8);
		_bss_end = .;
	}

	. = ALIGN(0x1000);

	/* End of the linked RAM footprint, rounded up for page-table mappings. */
	ld_ram_end = .;

	ASSERT((ld_image_header_start == ld_ram_start) &&
		(((ld_image_header_end - ld_image_header_start) == 0) ||
		 ((ld_image_header_end - ld_image_header_start) == 64)),
		"AArch64 Image header must be absent or 64 bytes at offset zero")
	ASSERT(_start == ld_image_header_end,
		"EL2 entry must immediately follow the optional AArch64 Image header")
	ASSERT(CONFIG_HV_RAM_SIZE > 0,
		"CONFIG_HV_RAM_SIZE must be non-zero")
	ASSERT(ld_ram_end <= (CONFIG_HV_RAM_START + CONFIG_HV_RAM_SIZE),
		"BEAU RAM footprint exceeds CONFIG_HV_RAM_SIZE")
}
