## sdk/bsp/Kconfig
```kconfig
#
# BEAU HYPERVISOR 2026
#
# SPDX-License-Identifier: BSD-3-Clause
#

menu "BSP"

config HAS_HSM
	bool "Enable HSM-backed I/O request path"
	default n
	help
	  Enable code paths that depend on the legacy HSM I/O request model.
	  Static ARM64 platforms use BEAU-owned MMIO dispatch and leave this
	  disabled.

config SERIAL_8250_PCI
	bool "Use PCI 8250 serial port"
	default n
	help
	  Route the debug serial driver through a PCI 8250 device. ARM64 QEMU
	  and rk356x use MMIO serial devices instead.

config CONSOLE_DEFAULT_VM
	string "Default console VM"
	default "ACRN_INVALID_VMID"
	help
	  Initial VM console owner. ACRN_INVALID_VMID means the BEAU shell owns
	  host input and output until a vsh command selects a VM.

config CONSOLE_LOGLEVEL_DEFAULT
	int "Default console log level"
	default 6
	help
	  Initial console log level used by BEAU logging.

config MEM_LOGLEVEL_DEFAULT
	int "Default memory log level"
	default 0
	help
	  Initial memory log category verbosity.

config HOST_DMESG_RING_SIZE
	int "Host dmesg ring size"
	default 65536
	range 4096 1048576
	help
	  Static storage budget in bytes for retained BEAU host log records. The
	  dmesg shell command reads the newest complete records after the live
	  console stream has moved on. Full rings overwrite the oldest records.

config COREMARK
	bool "CoreMark parallel diagnostic"
	default y if STATIC_ARM64_PLATFORM
	help
	  Build the fixed CoreMark upstream snapshot and expose the asynchronous
	  coremark [iterations] shell command. It runs one context on every active
	  pCPU and reports scheduler-inclusive EL2 diagnostic results.

if COREMARK

config COREMARK_MAX_ITERATIONS
	int "Maximum explicit CoreMark iterations"
	default 1000000
	range 1 10000000
	help
	  Upper bound for an explicit coremark iteration argument. Zero selects the
	  upstream automatic calibration path, which targets at least ten seconds.

config COREMARK_START_TIMEOUT_MS
	int "CoreMark pCPU start timeout in milliseconds"
	default 250
	range 10 10000
	help
	  Maximum time a dispatched pCPU worker may remain queued before the
	  generation reports that pCPU as unavailable. The worker context remains
	  reserved until a delayed wakeup completes.

config COREMARK_RUN_TIMEOUT_MS
	int "CoreMark pCPU completion timeout in milliseconds"
	default 30000
	range 1000 120000
	help
	  Maximum time a running pCPU worker may take before the generation reports
	  a partial result. BEAU does not forcibly stop a late worker; its fixed
	  context remains reserved until completion.

endif

config DHRYSTONE
	bool "Dhrystone serialized diagnostic"
	default y if STATIC_ARM64_PLATFORM
	help
	  Build the Dhrystone 2.2a port and expose the asynchronous dhrystone
	  [initial-runs] shell command. The upstream global state runs on one pCPU
	  at a time and reports each pCPU separately.

if DHRYSTONE

config DHRYSTONE_MAX_INITIAL_RUNS
	int "Maximum Dhrystone initial runs"
	default 10000000
	range 1 100000000
	help
	  Upper bound for the optional initial run count. Dhrystone preserves its
	  upstream two-second measurement rule and may increase this value by ten.

config DHRYSTONE_START_TIMEOUT_MS
	int "Dhrystone pCPU start timeout in milliseconds"
	default 5000
	range 10 10000
	help
	  Maximum time a pinned worker may remain queued before BEAU atomically
	  cancels it before execution. This covers BVT catch-up after a prior
	  diagnostic run without permitting deferred background work.

config DHRYSTONE_RUN_TIMEOUT_MS
	int "Dhrystone pCPU completion timeout in milliseconds"
	default 30000
	range 1000 120000
	help
	  Maximum time one pCPU Dhrystone execution may take before BEAU marks it
	  late. A late worker retains command ownership until it completes, so a
	  completed command never leaves benchmark work running in the background.

endif

config NPK_LOGLEVEL_DEFAULT
	int "Default NPK log level"
	default 0
	help
	  Initial NPK log category verbosity. Static ARM64 builds keep this at
	  zero unless tracing support is added.

config VUART_TIMER_PCPU
	string "vUART timer pCPU"
	default "BSP_CPU_ID"
	help
	  CPU that owns the periodic vUART and console timer. BSP_CPU_ID keeps
	  timer ownership on the boot CPU.

config VUART_RX_BUF_SIZE
	int "vUART RX buffer size"
	default 256
	help
	  Receive buffer size in bytes for each virtual UART.

config VUART_TX_BUF_SIZE
	int "vUART TX buffer size"
	default 256
	help
	  Transmit buffer size in bytes for each virtual UART.

config VM_CONSOLE_RINGBUF_VM_NUM
	string "VM console ring buffer count"
	default "(PRE_VM_NUM + SERVICE_VM_NUM)"
	help
	  Number of per-VM console ring buffers. The default covers all static
	  pre-launched and service VMs.

config VM_CONSOLE_RINGBUF_SIZE
	int "VM console ring buffer size"
	default 4096
	help
	  Per-VM console ring buffer size in bytes. This must stay a power of
	  two for the ring mask logic in sdk/bsp/console.c.

config MAX_MSIX_TABLE_NUM
	int "Maximum MSI-X table entries"
	default 16
	help
	  Static allocation limit for emulated or passthrough MSI-X table
	  entries.

config MAX_PCI_DEV_NUM
	int "Maximum PCI devices"
	default 16
	help
	  Static allocation limit for BEAU PCI physical and virtual device
	  records.

config MAX_IOAPIC_NUM
	int "Maximum IOAPIC count"
	default 0
	help
	  Static IOAPIC allocation count. ARM64 static platforms use GIC and set
	  this to zero.

config SPACE_SIZE
	hex "PCI MMCONFIG space size"
	default 0x10000000
	help
	  Compatibility value used by shared PCI code for MMCONFIG space sizing.

config ADDR
	hex "PCI config address port"
	default 0xcf8
	help
	  Compatibility value for legacy PCI configuration address port.

config DATA
	hex "PCI config data port"
	default 0xcfc
	help
	  Compatibility value for legacy PCI configuration data port.

config IGD_SBDF
	hex "Integrated graphics SBDF"
	default 0
	help
	  Compatibility SBDF used by shared passthrough PCI code. Static ARM64
	  platforms do not currently pass through IGD.

config PRE_VM_NUM
	int "Pre-launched VM count"
	default 2
	help
	  Number of pre-launched VMs in the static ARM64 scenario.

config SERVICE_VM_NUM
	int "Service VM count"
	default 1
	help
	  Number of service VMs in the static ARM64 scenario.

config MAX_POST_VM_NUM
	int "Maximum post-launched VM count"
	default 0
	help
	  Static allocation limit for post-launched VMs. Current ARM64 static
	  platforms do not use post-launched VMs.

config MAX_TRUSTY_VM_NUM
	int "Maximum Trusty VM count"
	default 0
	help
	  Static allocation limit for Trusty VMs. Current ARM64 static platforms
	  do not use Trusty VMs.

config MAX_VUART_NUM_PER_VM
	int "Maximum vUARTs per VM"
	default 2
	help
	  Number of virtual UART configuration slots per VM.

config RTVM_SEVERITY_LEVEL
	hex "RTVM severity level"
	default 0x30
	help
	  Compatibility severity value used for real-time VM configuration.

menuconfig CPUFREQ
	bool "BSP CPU frequency policy"
	default y if STATIC_ARM64_PLATFORM
	help
	  Enable the BEAU BSP CPU frequency policy. The first implementation is
	  host-only and consumes static platform DTS policy.

if CPUFREQ

config CPUFREQ_EXPECTED_CPUS
	int "Expected CPUFreq CPU count"
	default 8 if PLATFORM_QEMU
	default 4 if PLATFORM_RK356X
	default 8
	range 1 64
	help
	  Number of host pCPUs that the enabled CPUFreq DTS domain must cover.

choice CPUFREQ_POLICY
	prompt "CPUFreq policy"
	default CPUFREQ_POLICY_PERFORMANCE

config CPUFREQ_POLICY_PERFORMANCE
	bool "Performance"
	help
	  Always select the highest configured P-state.

endchoice

choice CPUFREQ_BACKEND
	prompt "CPUFreq backend"
	default CPUFREQ_BACKEND_STUB

config CPUFREQ_BACKEND_STUB
	bool "Stub"
	help
	  Record the selected P-state without changing hardware frequency.

endchoice

endif

source "sdk/bsp/acpi/Kconfig"
source "sdk/bsp/arm64/Kconfig"
source "sdk/bsp/boot/Kconfig"
source "sdk/bsp/pci/Kconfig"
source "sdk/bsp/virtio/Kconfig"

endmenu
```

## sdk/bsp/acpi/Kconfig
```kconfig
#
# BEAU HYPERVISOR 2026
#
# SPDX-License-Identifier: BSD-3-Clause
#

menu "ACPI"

config ACPI_PARSE_ENABLED
	bool "Enable ACPI table parser"
	default n
	help
	  Enable ACPI parsing support for platforms that boot from ACPI tables.
	  Static ARM64 QEMU and rk356x use device tree policy instead.

endmenu
```

## sdk/bsp/boot/Kconfig
```kconfig
#
# BEAU HYPERVISOR 2026
#
# SPDX-License-Identifier: BSD-3-Clause
#

menu "Boot"

config MULTIBOOT2
	bool "Enable Multiboot2 parser"
	default n
	help
	  Compile Multiboot2 parsing support. Static ARM64 platforms normally
	  use bare boot with staged modules instead.

endmenu
```

## sdk/bsp/pci/Kconfig
```kconfig
#
# BEAU HYPERVISOR 2026
#
# SPDX-License-Identifier: BSD-3-Clause
#

menu "PCI"

config SECURITY_VM_FIXUP
	bool "Enable security VM ACPI fixup"
	default n
	help
	  Enable legacy ACPI fixups for security VM device ownership.

endmenu
```

## sdk/bsp/virtio/Kconfig
```kconfig
#
# BEAU HYPERVISOR 2026
#
# SPDX-License-Identifier: BSD-3-Clause
#

menu "Virtio"

comment "No configurable virtio options"

endmenu
```

## sdk/bsp/vpci/Kconfig
```kconfig
#
# BEAU HYPERVISOR 2026
#
# SPDX-License-Identifier: BSD-3-Clause
#

menu "Virtual PCI"

config VMCS9900
	bool "Enable VMCS9900 vUART backend"
	default n
	help
	  Compile the legacy VMCS9900 virtual UART path.

endmenu
```

## sdk/kbe/Kconfig
```kconfig
# SPDX-License-Identifier: GPL-2.0-only

menuconfig BEAU
	bool "BEAU hypervisor guest drivers"
	depends on ARM64
	default y
	help
	  Enable BEAU hypervisor paravirtual guest support.

if BEAU

config BEAU_VWDT
	bool "BEAU hypervisor watchdog heartbeat"
	default y
	help
	  Run one pinned heartbeat thread per online CPU and periodically kick the
	  BEAU hypervisor VM watchdog. The timer only wakes the thread, so a kick
	  proves that process context made scheduling progress on that CPU. BEAU can
	  identify and recover the VM when one CPU stops making progress.

config BEAU_CRASH_REPORTER
	bool "BEAU guest panic and oops reporting"
	default y
	help
	  Notify the BEAU Host through HVC when Linux enters panic or an ARM64
	  DIE_OOPS path. The Host records the bounded diagnostic message and makes
	  it available through the BEAU shell crash command and Host dmesg log.

config BEAU_EDU_TEST
	bool "BEAU QEMU edu PCI passthrough test"
	depends on PCI && PCI_MSI
	default y
	help
	  Probe the QEMU edu PCI endpoint used by BEAU VM2 passthrough
	  validation. The driver enables BAR MMIO, allocates one MSI/MSI-X
	  vector, raises one device interrupt, and reports whether the
	  interrupt handler observed it.

config BEAU_IPC_TEST
	bool "BEAU static IPC validation endpoint"
	default y
	help
	  Join the first BEAU IPC channel visible to this VM, map its shared
	  SPSC rings, and exchange length-prefixed validation messages with the
	  peer endpoint through HC_IPC notifications.

config BEAU_VIRTIOFS_BACKEND
	bool "BEAU VM2 virtio-fs backend"
	depends on VIRTIO_FS
	help
	  Service BEAU virtio-proxy requests from a backend Linux VM.

	  This first backend is intentionally small: it lets a frontend VM mount
	  a virtio-fs export backed by the backend VM's /var/beau
	  directory. BEAU still owns only the MMIO transport and descriptor
	  copying; this driver owns FUSE request semantics and VFS access.

config BEAU_VIRTIORNG_BACKEND
	bool "BEAU VM2 virtio-rng backend"
	help
	  Service BEAU virtio-proxy RNG requests from a backend Linux VM.

	  Enable this with a frontend virtio-proxy device advertising virtio RNG
	  device id 4. VM3's standard virtio-rng frontend supplies writable
	  buffers; VM2 fills them with kernel random bytes and completes the
	  descriptor through BEAU.

config BEAU_VIRTIOBLK_BACKEND
	bool "BEAU VM2 virtio-blk RAM backend"
	default y
	help
	  Service BEAU virtio-proxy block requests from a backend Linux VM.

	  Enable this with a frontend virtio-proxy device advertising virtio BLK
	  device id 2. VM3's standard virtio-blk frontend sends request headers,
	  data buffers, and status descriptors; VM2 stores data in a small RAM
	  disk and completes the descriptor through BEAU.

config BEAU_VIRTIOI2C_BACKEND
	bool "BEAU VM2 virtio-i2c EEPROM backend"
	default y
	help
	  Service BEAU virtio-proxy I2C requests from a backend Linux VM.

	  Enable this with a frontend virtio-proxy device advertising virtio I2C
	  adapter device id 34. VM3's standard virtio-i2c frontend sends I2C
	  message descriptors; VM2 exposes a small in-memory device at 7-bit
	  address 0x50 for QEMU validation with i2c-tools.

config BEAU_VIRTIONET_BACKEND
	bool "BEAU VM2 virtio-net uplink backend"
	depends on NET
	default y
	help
	  Service BEAU virtio-proxy network requests from a backend Linux VM.

	  Enable this with a frontend virtio-proxy device advertising virtio NET
	  device id 1. VM3's standard virtio-net frontend exchanges Ethernet
	  frames with VM2. VM2 forwards those frames through one uplink netdev,
	  selected by the backend's uplink parameter and defaulting to eth0.

endif
```
