## Kconfig
```kconfig
#
# BEAU HYPERVISOR 2026
#
# Copyright (C) 2026 Hustler Lo.
# SPDX-License-Identifier: BSD-3-Clause
#

mainmenu "BEAU HYPERVISOR Configuration"

source "arch/Kconfig"
source "core/Kconfig"
source "lib/Kconfig"
source "sdk/bsp/Kconfig"
```

## arch/Kconfig
```kconfig
#
# BEAU HYPERVISOR 2026
#
# Copyright (C) 2026 Hustler Lo.
# SPDX-License-Identifier: BSD-3-Clause
#

menu "Architecture"

choice ARCH_CHOICE
	prompt "Target architecture"
	default ARM64
	help
	  Select the CPU architecture to build BEAU for. The current in-tree
	  hypervisor build path is ARM64.

config ARM64
	bool "ARM64"
	help
	  Build the ARM64 EL2 hypervisor implementation used by the QEMU virt
	  and rk356x platform ports.

endchoice

source "arch/arm64/Kconfig"

endmenu
```

## arch/arm64/Kconfig
```kconfig
#
# BEAU HYPERVISOR 2026
#
# SPDX-License-Identifier: BSD-3-Clause
#

if ARM64

menu "ARM64 Options"

config STATIC_ARM64_PLATFORM
	bool
	default y
	help
	  Use the BEAU ARM64 static platform path. Static platform builds read
	  platform policy from arch/arm64/platform/<platform>/platform.dts and
	  only keep compile-time limits in Kconfig.

config RELOC
	bool "Build relocatable hypervisor image"
	default n
	help
	  Build the hypervisor as a position-independent image. The current
	  QEMU and rk356x bring-up defaults link BEAU at the platform RAM base,
	  so leave this disabled unless the boot path is updated accordingly.

config AARCH64_IMAGE_HEADER
	bool "Emit AArch64 Image header"
	default n
	help
	  Put the 64-byte AArch64 Image header used by Zephyr and Linux at
	  offset zero of the raw BEAU image. This allows U-Boot booti to find
	  the load size, page-size flags, and ARM64 magic before branching to
	  the EL2 entry point. This is not a PE/COFF UEFI application header.

config HV_RAM_START
	hex "Hypervisor RAM link address"
	default 0x50000000 if PLATFORM_QEMU
	default 0x00A00000 if PLATFORM_RK356X
	help
	  Link-time address where firmware or QEMU places the BEAU image. This
	  value is substituted into arch/lds/link_ram.ld.in.

config HV_RAM_SIZE
	hex "Hypervisor reserved RAM size"
	default 0x08000000 if PLATFORM_QEMU
	default 0x0F600000 if PLATFORM_RK356X
	help
	  Maximum RAM footprint available to BEAU from CONFIG_HV_RAM_START.
	  The linker rejects text, embedded images, data, stacks, or BSS that
	  extend beyond this platform-owned range.

config MAX_PCPU_NUM
	int "Maximum physical CPU count"
	default 8 if PLATFORM_QEMU
	default 4 if PLATFORM_RK356X
	range 1 64
	help
	  Compile-time upper bound for host physical CPUs. The runtime CPU list
	  still comes from the platform device tree.

config STACK_SIZE
	int "Thread stack size"
	default 8192
	help
	  Stack size in bytes for BEAU threads, vCPUs, shell, watchdog, and
	  per-pCPU stacks.

config ARM64_MTE
	bool "ARM64 EL2 Memory Tagging Extension"
	default y
	help
	  Build BEAU EL2 Memory Tagging Extension support. FEAT_MTE2 or newer
	  is detected at runtime; older CPUs keep the existing untagged memory
	  path. The initial implementation protects BEAU-owned page-table pools
	  and does not expose MTE to guests.

config PERF
	bool "ARM64 EL2 sampling profiler"
	default n
	help
	  Build the bounded host sampling profiler and its shell command. The
	  profiler is stopped at boot, records raw Host text addresses in fixed
	  per-pCPU rings, and never unwinds a guest stack.

config ARM64_SPE
	bool "ARM64 Statistical Profiling Extension"
	default n
	help
	  Build EL2-owned Arm SPE collection. The feature is unavailable unless the
	  platform supplies an SPE PPI and the CPU advertises PMSVer.

config ARM64_SPE_BUFFER_SIZE
	int "ARM64 SPE buffer size per pCPU"
	default 65536
	range 8192 1048576
	help
	  Static per-pCPU buffer split into two 4 KiB-aligned halves.

source "arch/arm64/platform/Kconfig"
source "arch/arm64/gic/Kconfig"
source "arch/arm64/guest/Kconfig"

endmenu

endif
```

## arch/arm64/gic/Kconfig
```kconfig
#
# BEAU HYPERVISOR 2026
#
# SPDX-License-Identifier: BSD-3-Clause
#

menu "ARM64 Interrupt Controller"

config ARM64_GICV5
	bool "Use ARM GICv5 sources"
	default n
	help
	  Build the experimental GICv5 implementation instead of the default
	  GICv3 path. Enable only when validating a platform that provides the
	  matching GICv5 hardware model.

config IRQSTAT_LATENCY
	bool "Collect interrupt latency statistics"
	default y if PLATFORM_QEMU
	default n if PLATFORM_RK356X
	help
	  Track assert-to-LR and assert-to-EOI timing for host and virtual
	  interrupts. This is useful for QEMU diagnosis and can be disabled on
	  constrained hardware builds.

endmenu
```

## arch/arm64/guest/Kconfig
```kconfig
#
# BEAU HYPERVISOR 2026
#
# SPDX-License-Identifier: BSD-3-Clause
#

menu "ARM64 Guest Boot"

config GUEST_KERNEL_RAWIMAGE
	bool "Enable raw guest image loader"
	default y
	help
	  Enable loading raw RTOS or Linux images from staged modules into the
	  guest RAM window selected by platform.dts.

config GUEST_KERNEL_BZIMAGE
	bool "Enable bzImage guest loader"
	default n
	help
	  Enable the legacy bzImage loader. Static ARM64 platforms normally keep
	  this disabled.

config GUEST_KERNEL_ELF
	bool "Enable ELF guest loader"
	default n
	help
	  Enable the ELF guest loader for platforms that provide ELF modules.
	  The default QEMU and rk356x flows use raw images.

config STATIC_VFDT
	bool "Generate static guest FDTs"
	default y
	help
	  Build BEAU's static guest FDT generation path. Linux guests receive
	  their BEAU-supplied DTB from the hypervisor instead of firmware.

config ENABLE_VM1_LK
	bool "Boot LK as VM1 on QEMU"
	default n
	depends on PLATFORM_QEMU
	help
	  Replace the default Linux-1 VM with the optional LK RTOS image in the
	  QEMU static scenario.

endmenu
```

## arch/arm64/platform/Kconfig
```kconfig
#
# BEAU HYPERVISOR 2026
#
# SPDX-License-Identifier: BSD-3-Clause
#

menu "ARM64 Platform"

choice PLATFORM_CHOICE
	prompt "ARM64 platform"
	default PLATFORM_QEMU
	help
	  Select the static ARM64 platform to build. The selected platform
	  controls default build output naming, platform.dts input, and default
	  compile-time limits.

config PLATFORM_QEMU
	bool "QEMU virt"
	help
	  Build the ARM64 QEMU virt platform using GICv3, PL011, and the
	  default three-VM development scenario.

config PLATFORM_RK356X
	bool "Rockchip rk356x"
	help
	  Build the rk356x hardware-platform skeleton. Hardware validation is
	  still board-specific and manual.

endchoice

config BOARD
	string
	default "qemu" if PLATFORM_QEMU
	default "rk356x" if PLATFORM_RK356X
	help
	  Human-readable board name written into generated build metadata.

config SCENARIO
	string
	default "qemu" if PLATFORM_QEMU
	default "rk356x" if PLATFORM_RK356X
	help
	  Scenario name written into generated build metadata. Static ARM64
	  platforms use the platform name as the scenario name.

config STATIC_QEMU_PLATFORM
	bool
	default y if PLATFORM_QEMU
	help
	  Internal compatibility macro for QEMU-specific static platform code.

config STATIC_RK356X_PLATFORM
	bool
	default y if PLATFORM_RK356X
	help
	  Internal compatibility macro for rk356x-specific static platform code.

config QEMU_PM_SIMULATED
	bool
	default y if PLATFORM_QEMU
	help
	  Build the QEMU WFI/QMP-assisted simulated suspend backend.

config QEMU_PM_STRICT
	bool
	default n
	depends on PLATFORM_QEMU
	help
	  Enable acceptance of the firmware PSCI SYSTEM_SUSPEND backend.

endmenu
```

## core/Kconfig
```kconfig
#
# BEAU HYPERVISOR 2026
#
# SPDX-License-Identifier: BSD-3-Clause
#

menu "Core"

config AUTOSTART_VM
	bool "Autostart static VMs"
	default y
	help
	  Start configured static VMs during BEAU boot. Disable only for bring-up
	  flows that need to create or start VMs manually from the shell.

config LAUNCH_VMS_FROM_BSP
	bool "Launch static VMs from the BSP"
	default y
	help
	  Launch static VMs from the boot CPU after platform initialization.
	  The current ARM64 static platform path expects this to be enabled.

config SCHED_DTS
	bool
	default y
	help
	  Compile all built-in scheduler backends. Runtime policy is selected
	  from /hypervisor/sched cpupool nodes in the static platform device tree.

config SCHED_NOOP
	bool
	default y if SCHED_DTS
	help
	  Internal compatibility symbol selecting no-op scheduler code.

config SCHED_IORR
	bool
	default y if SCHED_DTS
	help
	  Internal compatibility symbol selecting I/O round-robin scheduler code.

config SCHED_BVT
	bool
	default y if SCHED_DTS
	help
	  Internal compatibility symbol selecting BVT scheduler code.

config SCHED_RTDS
	bool
	default y if SCHED_DTS
	help
	  Internal compatibility symbol selecting RTDS scheduler code.

config SCHED_CBS
	bool
	default y if SCHED_DTS
	help
	  Internal compatibility symbol selecting CBS scheduler code.

config SCHED_BVT_MCU_MS
	int "BVT minimum charging unit in milliseconds"
	default 1
	range 1 100
	depends on SCHED_BVT
	help
	  Minimum charging unit used by the BVT virtual-time scheduler.
	  Smaller values improve responsiveness at the cost of more timer activity.

config SCHED_BVT_CSA_MCU
	int "BVT context-switch allowance in MCU units"
	default 5
	range 1 100
	depends on SCHED_BVT
	help
	  Extra BVT runtime allowance, expressed in BVT MCU units, used when
	  programming the one-shot scheduler timer. Increase it to reduce timer
	  churn; decrease it to reduce wake and fairness latency.

config SCHED_PRIO
	bool
	default y if SCHED_DTS
	help
	  Internal compatibility symbol selecting priority scheduler code.

config ACRNTRACE_ENABLED
	bool "Enable BEAU runtime trace capture"
	default y
	help
	  Compile the low-overhead per-pCPU trace producer and shell capture
	  controls. Capture remains stopped at boot until the trace shell command
	  starts it.

config TRACE_RECORDS_PER_CPU
	int "Trace records retained per pCPU"
	default 256
	range 32 4096
	depends on ACRNTRACE_ENABLED
	help
	  Number of fixed 32-byte records retained in each pCPU trace ring. Full
	  rings overwrite their oldest records and account the overwrite count.

config MAX_EMULATED_MMIO_REGIONS
	int "Maximum emulated MMIO regions per VM"
	default 8
	help
	  Static allocation limit for MMIO traps owned by BEAU emulation code.

config MAX_PT_IRQ_ENTRIES
	int "Maximum passthrough IRQ entries"
	default 32
	help
	  Static allocation limit for physical interrupt remapping records.

config VM_WDT_MONITOR_VM_NUM
	int "VM watchdog monitor count"
	default 3
	help
	  Number of VM IDs scanned by the VM watchdog task.

config VM_WDT_PRINT_PERIOD_MS
	int "VM watchdog print period in milliseconds"
	default 5000
	help
	  Minimum time between repeated watchdog diagnostic prints.

config VM_WDT_TIMEOUT_MS
	int "VM watchdog timeout in milliseconds"
	default 15000
	help
	  VM heartbeat age that is considered timed out by the watchdog.

config VM_WDT_RESTART_VM_MASK
	hex "VM watchdog auto-restart VM mask"
	default 0
	help
	  Bit n enables automatic restart of VM n after its watchdog heartbeat
	  times out. Enable only guests that include an HC_VM_WDT_KICK source.
	  Service VMs are never restarted by the watchdog.

config VM_WDT_RESTART_MAX
	int "Maximum watchdog recovery attempts per VM boot"
	default 3
	help
	  Limits automatic restarts after a VM watchdog timeout. The count survives
	  VM restarts for the lifetime of one VM instance, preventing a guest that
	  cannot boot from entering an infinite watchdog reset loop.

endmenu
```

## lib/Kconfig
```kconfig
#
# BEAU HYPERVISOR 2026
#
# SPDX-License-Identifier: BSD-3-Clause
#

menu "Libraries"

config FDT_PARSE_ENABLED
	bool "Enable runtime FDT parser"
	default n
	help
	  Enable the runtime FDT parser path. Static ARM64 platforms currently
	  use the static guest FDT path and leave this disabled.

endmenu
```
